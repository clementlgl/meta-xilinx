## meta-xilinx-bsp/conf/machine/minized-zynq7.conf
```bitbake
#@TYPE: Machine
#@NAME: minized-zynq7
#@DESCRIPTION: Machine support for MiniZed. (http://www.minized.org/)

require conf/machine/include/tune-zynq.inc
require conf/machine/include/machine-xilinx-default.inc
require conf/machine/include/machine-xilinx-board.inc

MACHINE_FEATURES = "ext2 vfat usbhost"

KERNEL_IMAGETYPE="zImage"

# u-boot configuration
UBOOT_MACHINE = "zynq_minized_config"
SPL_BINARY = "spl/boot.bin"

SERIAL_CONSOLE = "115200 ttyPS0"

MACHINE_ESSENTIAL_EXTRA_RDEPENDS += "device-tree"

IMAGE_BOOT_FILES += " \
		boot.bin \
		${MACHINE}.dtb \
		"
```
